## cfr-linux/meta-cfr-compute/conf/layer.conf
```bitbake
# We have a conf and classes directory, add to BBPATH
BBPATH .= ":${LAYERDIR}"

# We have recipes-* directories, add to BBFILES
BBFILES += "${LAYERDIR}/recipes-*/*/*.bb \
            ${LAYERDIR}/recipes-*/*/*.bbappend"

BBFILE_COLLECTIONS += "meta-cfr-base"
BBFILE_PATTERN_meta-cfr-base = "^${LAYERDIR}/"
BBFILE_PRIORITY_meta-cfr-base = "10"

LAYERDEPENDS_meta-cfr-base = "core"
LAYERSERIES_COMPAT_meta-cfr-base = "scarthgap"

LICENSE_FLAGS_ACCEPTED = "synaptics-killswitch"
PACKAGE_CLASSES = "package_deb"

IMAGE_INSTALL:append = " iproute2 openssh ethtool openssh-sshd"
EXTRA_IMAGE_FEATURES:append = " debug-tweaks allow-empty-password allow-root-login empty-root-password"

DISTRO_FEATURES:append = " systemd usrmerge"
VIRTUAL-RUNTIME_init_manager = "systemd"
VIRTUAL-RUNTIME_initscripts = "systemd-compat-units"

IMAGE_FSTYPES += "wic"
```
